/dts-v1/;
/plugin/;
/ {
    compatible="brcm,bcm2835";
    fragment@0 {
        target=<&uart1>;
        __overlay__ {
            uart_14_and_15 {
                compatible="piuartdev";
            };
        };
    };
};
